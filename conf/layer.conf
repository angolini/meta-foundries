## conf/layer.conf
```bitbake
# We have a conf and classes directory, add to BBPATH
BBPATH .= ":${LAYERDIR}"

# We have recipes-* directories, add to BBFILES
BBFILES += "${LAYERDIR}/recipes-*/*/*.bb \
            ${LAYERDIR}/recipes-*/*/*.bbappend"

BBFILES_DYNAMIC += " \
    virtualization-layer:${LAYERDIR}/dynamic-layers/virtualization-layer/recipes-*/*/*.bb \
    virtualization-layer:${LAYERDIR}/dynamic-layers/virtualization-layer/recipes-*/*/*.bbappend \
"

BBFILE_COLLECTIONS += "meta-foundries"
BBFILE_PATTERN_meta-foundries = "^${LAYERDIR}/"
BBFILE_PRIORITY_meta-foundries = "6"

LAYERDEPENDS_meta-foundries = "core openembedded-layer meta-python \
                               filesystems-layer sota"
LAYERSERIES_COMPAT_meta-foundries = "blacksail wrynose"

COMPOSE_APP_MANAGER ?= "composectl composectl-aklite-apps"
SOTA_CLIENT ?= "aktualizr-lite"

include conf/fio-documentation.conf
```
